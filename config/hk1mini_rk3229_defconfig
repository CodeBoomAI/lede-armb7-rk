## config/hk1mini_rk3229_defconfig
```kconfig
CONFIG_TARGET_rockchip_armv7=y
CONFIG_TARGET_rockchip_armv7_DEVICE_HK1MINI=y
CONFIG_TARGET_BOARD="rockchip"
CONFIG_TARGET_SUBTARGET="armv7"
CONFIG_TARGET_PROFILE="DEVICE_HK1MINI"

# Tambahan paket opsional:
CONFIG_PACKAGE_luci=y
CONFIG_PACKAGE_kmod-usb-storage=y
CONFIG_PACKAGE_kmod-fs-ext4=y
CONFIG_PACKAGE_kmod-usb-net=y
CONFIG_PACKAGE_kmod-usb-net-rtl8152=y
CONFIG_PACKAGE_kmod-fs-vfat=y
CONFIG_PACKAGE_kmod-leds-gpio=y
CONFIG_PACKAGE_kmod-rtc-sysfs=y
```
